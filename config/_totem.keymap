#include <behaviors.dtsi>
#define CONFIG_WIRELESS
#define ZMK_BASE_LAYER(name, LT, RT, LM, RM, LB, RB, LH, RH)  \
    ZMK_LAYER(                                                                 \
        name,                                                                  \
                 LT RT                                                         \
                 LM RM                                                         \
                 &kp ESC LB RB &kp BSLH                                        \
                 SMART_NUM LH RH SMART_SHIFT \
    )

#define THUMBS LH2 LH1 LH0 RH0 RH1 RH2                                    // Thumb keys.
#define PM_KEY &none
