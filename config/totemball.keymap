#include <behaviors.dtsi>
#define CONFIG_WIRELESS
#define CONFIG_TRACKBALL
#define ZMK_BASE_LAYER(name, LT, RT, LM, RM, LB, RB, LH, RH)  \
    ZMK_LAYER(                                                                 \
        name,                                                                  \
                 LT RT                                                         \
                 LM RM                                                         \
                 &kp ESC LB RB &kp BSLH                                        \
                 SMART_NUM LH RH SMART_SHIFT \
    )

#include "zmk-helpers/key-labels/totem.h"

#define KEYS_L LT0 LT1 LT2 LT3 LT4 LM0 LM1 LM2 LM3 LM4 LB0 LB1 LB2 LB3 LB4 LB5 // Left-hand keys.
#define KEYS_R RT0 RT1 RT2 RT3 RT4 RM0 RM1 RM2 RM3 RM4 RB0 RB1 RB2 RB3 RB4 RB5 // Right-hand keys.
#define PM_KEY &none

/ {
    aliases {
        led-red = &led0;
        led-green = &led1;
        led-blue = &led2;
    };
};

#include "base.keymap"