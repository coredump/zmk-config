/*
 * Copyright (c) 2020 The ZMK Contributors
 *
 * SPDX-License-Identifier: MIT
 */

#include <behaviors.dtsi>
#include <dt-bindings/zmk/keys.h>
#include <dt-bindings/zmk/bt.h>
#include <dt-bindings/zmk/rgb.h>
#include <dt-bindings/zmk/ext_power.h>
#include <behaviors/num_word.dtsi>
#include "zmk-helpers/helper.h"
#include <dt-bindings/zmk/outputs.h>

#include <behaviors/rgbled_widget.dtsi>

#ifndef KEYS_L
#define KEYS_L LT0 LT1 LT2 LT3 LT4 LM0 LM1 LM2 LM3 LM4 LB0 LB1 LB2 LB3 LB4 LB5 // Left-hand keys.
#endif

#ifndef KEYS_R
#define KEYS_R RT0 RT1 RT2 RT3 RT4 RM0 RM1 RM2 RM3 RM4 RB0 RB1 RB2 RB3 RB4 RB5 // Right-hand keys.
#endif

#ifndef THUMBS
#define THUMBS LH2 LH1 LH0 RH0 RH1 RH2                                    // Thumb keys.
#endif

#ifndef PM_KEY
#define PM_KEY &none
#endif

#define BASE 0
#define MAC 1
#define GAMING 2
#define LOWER 3
#define RAISE 4
#define ADJUST 5
#define MOUSE 6
#define NUM 7
#define NAV 8
#define MACNAV 9

#ifdef CONFIG_TRACKBALL
#define SNIPE 10
#define WARP 11
#define SCROLL 12
#endif

#define QUICK_TAP_MS 175
#define CANCEL    &kp K_CANCEL            // Cancel caps-word & auto-layers.
#define ___ &trans
#define XXX &none


&sk {
	release-after-ms = <1200>;
	quick-release;
};

&lt {
    quick-tap-ms = <QUICK_TAP_MS>;
};

#define MAKE_HRM(NAME, HOLD, TAP, TRIGGER_POS)                                 \
  ZMK_HOLD_TAP(NAME, bindings = <HOLD>, <TAP>; flavor = "balanced";            \
               tapping-term-ms = <280>; quick-tap-ms = <QUICK_TAP_MS>;         \
               require-prior-idle-ms = <150>; hold-trigger-on-release;         \
               hold-trigger-key-positions = <TRIGGER_POS>;)

MAKE_HRM(hml, &kp, &kp, KEYS_R THUMBS) // Left-hand HRMs.
MAKE_HRM(hmr, &kp, &kp, KEYS_L THUMBS) // Right-hand HRMs.

// for the shifts
ZMK_HOLD_TAP(shml, bindings = <&kp>, <&kp>; flavor = "balanced";            \
           tapping-term-ms = <280>; quick-tap-ms = <QUICK_TAP_MS>;         \
           require-prior-idle-ms = <100>; hold-trigger-on-release;         \
           hold-trigger-key-positions = <KEYS_R THUMBS>;)

ZMK_HOLD_TAP(shmr, bindings = <&kp>, <&kp>; flavor = "balanced";            \
           tapping-term-ms = <280>; quick-tap-ms = <QUICK_TAP_MS>;         \
           require-prior-idle-ms = <100>; hold-trigger-on-release;         \
           hold-trigger-key-positions = <KEYS_L THUMBS>;)


// Alt+Tab swapper, requires tri-state module.
ZMK_TRI_STATE(win_sw, bindings = <&kt LALT>, <&kp TAB>, <&kt LALT>;
              ignored-key-positions = <LT2 RM2 RB1 RB2 RB3>; )

ZMK_TRI_STATE(mac_sw, bindings = <&kt LGUI>, <&kp TAB>, <&kt LGUI>;
              ignored-key-positions = <LT2 RM2 RB1 RB2 RB3>; )

ZMK_TRI_STATE(mac_app_sw, bindings = <&kt LGUI>, <&kp GRAVE>, <&kt LGUI>;
              ignored-key-positions = <LT2 RM2 RB1 RB2 RB3>; )

ZMK_TRI_STATE(ctrltab, bindings = <&kt LCTRL>, <&kp TAB>, <&kt LCTRL>;
              ignored-key-positions = <LT2 RT2 RM1 RM2 RM3>; )


ZMK_MACRO(win_prsc, bindings = < &kp LG(LS(S)) >;)
ZMK_MACRO(mac_prsc, bindings = < &kp LG(LS(N4)) >;)

// Hack: Make HRM combos tap-only (cf, ZMK issue #544).
#define ZMK_COMBO_8(NAME, TAP, POS, LAYERS, COMBO_MS, IDLE_MS, HOLD, SIDE)     \
  MAKE_HRM(hm_combo_##NAME, &kp, TAP, SIDE THUMBS)                             \
  ZMK_COMBO_6(NAME, &hm_combo_##NAME HOLD 0, POS, LAYERS, COMBO_MS, IDLE_MS)

#include "combos.dtsi"


#include <dt-bindings/zmk/pointing.h>
#include <input/processors.dtsi>
#include <zephyr/dt-bindings/input/input-event-codes.h>

#ifndef CONFIG_TRACKBALL
#include "mouse.dtsi"
ZMK_TRI_STATE(
    smart_mouse, bindings = <&tog MOUSE>, <&none>, <&tog MOUSE>;
    ignored-key-positions = <LB3 LB4 LH1 RH1 RH0 RT1 RT2 RT3 RM0 RM1 RM2 RM3 RM4 RB1 RB2 RB3>;
    ignored-layers = <MOUSE BASE LOWER RAISE>;)
#else
ZMK_TRI_STATE(
    smart_mouse, bindings = <&tog MOUSE>, <&none>, <&tog MOUSE>;
    ignored-key-positions = <LB3 LB4 LH1 RH1 RH0 RT1 RT2 RT3 RM0 RM1 RM2 RM3 RM4 RB1 RB2 RB3>;
    ignored-layers = <MOUSE BASE LOWER RAISE SCROLL SNIPE WARP>;)
#endif

ZMK_CONDITIONAL_LAYER(adjust, LOWER RAISE, ADJUST)

ZMK_ADAPTIVE_KEY(
	ak_space, bindings = <&kp SPACE>;
	akt_sentence { trigger-keys = <EXCL RS(SLASH) LS(SLASH) QMARK DOT>;
    bindings = <&kp SPACE &sk LSHFT>;
    };
)

// Tap:  double-tap: smart num-layer | triple tap: stick num.
ZMK_TAP_DANCE(num_dance, bindings = <&num_word NUM>, <&sl NUM>;
              tapping-term-ms = <200>;)

ZMK_MOD_MORPH(bs_del, bindings = <&kp BSPC>, <&kp DEL>;
              mods = <(MOD_LCTL|MOD_RCTL)>;)

ZMK_MOD_MORPH(grv_til, bindings = <&kp RA(GRAVE)>, <&kp LS(RA(GRAVE))>;
		      mods = <(MOD_LSFT|MOD_RSFT)>;)
ZMK_MOD_MORPH(q_grvtil, bindings = <&kp Q>, <&grv_til>;
		      mods = <(MOD_RALT)>;)

ZMK_MOD_MORPH(cedil, bindings = <&kp RA(COMMA)>, <&kp LS(RA(COMMA))>;
		      mods = <(MOD_LSFT|MOD_RSFT)>;)
ZMK_MOD_MORPH(c_cedil, bindings = <&kp C>, <&cedil>;
		      mods = <(MOD_RALT)>;)

ZMK_STICKY_KEY(sklazy, bindings = <&kp>;
               release-after-ms = <1200>;
			   lazy;)

ZMK_MOD_MORPH(win_quit, bindings = <&none>, <&kp LA(F4)>;
              mods = <(MOD_LCTL|MOD_RCTL)>;)

ZMK_MOD_MORPH(mac_quit, bindings = <&none>, <&kp LG(Q)>;
              mods = <(MOD_LGUI|MOD_RGUI)>;)

ZMK_MOD_MORPH(mac_lock, bindings = <&none>, <&kp LG(LC(Q))>;
              mods = <(MOD_LGUI|MOD_RGUI)>;)

ZMK_MOD_MORPH(win_lock, bindings = <&none>, <&kp LG(L)>;
              mods = <(MOD_LCTL|MOD_RCTL)>;)

#define LT_BSDEL &lt_bsdel RAISE 0
ZMK_HOLD_TAP(lt_bsdel, bindings = <&mo>, <&bs_del>; flavor = "balanced";
             tapping-term-ms = <200>; quick-tap-ms = <QUICK_TAP_MS>;)

#define LT_NUM &lt_num NUM 0
ZMK_HOLD_TAP(lt_num, bindings = <&mo>, <&ak_space>; flavor = "balanced";
             tapping-term-ms = <200>; quick-tap-ms = <QUICK_TAP_MS>;)


// Tap: num-word | double-tap: sticky num-layer | Hold: num-layer.
#define SMART_NUM &smart_num NUM 0
ZMK_HOLD_TAP(smart_num, bindings = <&mo>, <&num_dance>; flavor = "balanced";
             tapping-term-ms = <200>; quick-tap-ms = <QUICK_TAP_MS>;)
ZMK_TAP_DANCE(num_dance, bindings = <&num_word NUM>, <&sl NUM>;
              tapping-term-ms = <200>;)

// Tap: shift | double-tap: capsword | Hold: shift
#define SMART_SHIFT &smart_shift LSHFT 0
ZMK_HOLD_TAP(smart_shift, bindings = <&kp>, <&sft_dance>; flavor = "balanced";
             tapping-term-ms = <200>; quick-tap-ms = <QUICK_TAP_MS>;)
ZMK_TAP_DANCE(sft_dance, bindings = <&sk LSHFT>, <&caps_word>;
              tapping-term-ms = <200>;)

#ifndef ZMK_BASE_LAYER
  #define ZMK_BASE_LAYER(name, LT, RT, LM, RM, LB, RB, LH, RH)                 \
      ZMK_LAYER(name, LT RT LM RM LB RB LH RH)
#endif

ZMK_BASE_LAYER(Base,
    &q_grvtil       &kp W           &kp E            &kp R             &kp T         ,    &kp Y          &kp U           &kp I            &kp O            &kp P            ,
    &hml LGUI A     &hml LALT S     &hml LCTRL D     &shml LSHFT F     &kp G         ,    &kp H          &shmr RSHFT J   &hmr RCTRL K     &hmr RALT L      &hmr RGUI SEMI   ,
    &lt MOUSE Z     &kp X           &c_cedil         &kp V             &kp B         ,    &kp N          &kp M           &kp COMMA        &kp DOT          &kp SLASH        ,
                                                     &lt LOWER TAB     &lt NAV RET   ,    LT_NUM      LT_BSDEL
)

ZMK_BASE_LAYER(MacOS,
    ___             ___             ___              ___               ___           ,    ___            ___             ___              ___              ___              ,
    &hml LCTRL A    ___             &hml LGUI D      ___               ___           ,    ___            ___             &hmr RGUI K      ___              &hmr RCTRL SEMI  ,
    ___             ___             ___              ___               ___           ,    ___            ___             ___              ___              ___              ,
                                                     ___               &lt MACNAV RET,    ___            ___
)

ZMK_BASE_LAYER(Gaming,
    &kp TAB         &kp Q           &kp W            &kp E             &kp R         ,    ___            ___             ___              ___              ___              ,
    &kp ESC         &kp A           &kp S            &kp D             &kp F         ,    &kp H          &kp J           &kp K            &kp L            ___              ,
    &kp LSHFT       &kp Z           &kp X            &kp C             &kp V         ,    ___            ___             ___              ___              ___              ,
                                                     &kp LCTRL         &kp SPACE     ,    &kp RET        LT_BSDEL
)

ZMK_BASE_LAYER(Lower,
    &kp GRAVE       &kp LESS_THAN   &kp GREATER_THAN &kp MINUS         &kp PIPE      ,    &kp CARET      &kp LEFT_BRACE  &kp RIGHT_BRACE  &kp DOLLAR       &kp BACKSLASH    ,
    &kp EXCL        &kp ASTERISK    &kp SLASH        &kp EQUAL         &kp AMPS      ,    &kp HASH       &kp LPAR        &kp RPAR         &kp UNDERSCORE   &kp SQT          ,
    &kp TILDE       &kp PLUS        &kp LEFT_BRACKET &kp RIGHT_BRACKET &kp PERCENT   ,    &kp AT_SIGN    &kp COLON       ___              ___              ___              ,
                                                     ___                ___          ,    ___            ___
)

ZMK_BASE_LAYER(Raise,
    ___			   ___              ___              ___                ___          ,    &kp PG_UP      &kp HOME        &kp UP           &kp END          ___              ,
    &sklazy LGUI  &sklazy LALT      &sklazy LCTRL    &sklazy LSHFT      ___          ,    &kp PG_DN      &kp LEFT        &kp DOWN         &kp RIGHT        ___              ,
    ___            ___              ___              ___                &tog GAMING  ,    ___            ___             ___              ___              ___              ,
                                                     ___                ___          ,    ___            ___
)

ZMK_BASE_LAYER(Adjust,
    ___             ___             ___              ___               ___           ,    &bt BT_CLR     &bt BT_SEL 0    &bt BT_SEL 1     &bt BT_SEL 2     &out OUT_TOG     ,
    ___             ___             ___              ___               &tog MAC      ,    ___            ___             ___              ___              ___              ,
    &bootloader     ___             ___              ___               &tog GAMING   ,    &ind_bat       &ind_con        ___              ___              &bootloader      ,
                                                     ___               ___           ,    ___            ___
)

#ifndef CONFIG_TRACKBALL
ZMK_BASE_LAYER(Mouse,
    ___             ___             ___              ___               ___           ,    ___            U_WH_U          U_MS_U           U_WH_D           ___              ,
    ___             ___             ___              ___               ___           ,    U_WH_L         U_MS_L          U_MS_D           U_MS_R           U_WH_R           ,
    ___             ___             ___              ___               ___           ,    ___            &mkp LCLK       &mkp MCLK        &mkp RCLK        ___              ,
                                                     ___               ___           ,    CANCEL         ___
)
#else
ZMK_BASE_LAYER(Mouse,
    ___             ___             ___              ___               ___           ,    ___            ___             ___              ___              ___              ,
    ___             ___             ___              ___               ___           ,    ___            ___             ___              ___              ___              ,
    ___             &mo SCROLL      &mo SNIPE        &mo WARP          ___           ,    ___            &mkp LCLK       &mkp MCLK        &mkp RCLK        ___              ,
                                                     &mkp RCLK         &mkp LCLK     ,    &mkp MCLK      &mkp LCLK
)
#endif

ZMK_BASE_LAYER(Num,
    &kp N1          &kp N2          &kp N3           &kp N4            &kp N5        ,    &kp N6         &kp N7          &kp N8           &kp N9           &kp N0           ,
    &kp F1          &kp F2          &kp F3           &kp F4            &kp F5        ,    &kp F6         &kp F7          &kp F8           &kp F9           &kp F10          ,
    &kp F11         &kp F12         ___              ___               ___           ,    ___            ___             ___              ___              ___              ,
                                                     ___               ___           ,    CANCEL         LT_BSDEL
)

ZMK_BASE_LAYER(Nav,
    &win_lock       &mac_app_sw     &kp LS(TAB)      &ctrltab          &win_sw       ,    &kp PG_UP      &kp HOME        &kp UP           &kp END          ___              ,
    &win_quit       ___             ___              ___               &win_prsc     ,    &kp PG_DN      &kp LEFT        &kp DOWN         &kp RIGHT        ___              ,
    PM_KEY          ___             ___              ___               ___           ,    ___            &kp LG(LC(LEFT)) ___             &kp LG(LC(RIGHT))___              ,
                                                     ___               ___           ,    ___            ___
)

ZMK_BASE_LAYER(MacNav,
    &mac_lock       &mac_app_sw     &kp LS(TAB)      &ctrltab          &mac_sw       ,    &kp PG_UP      &kp HOME        &kp UP           &kp END          ___              ,
    &mac_quit       ___             ___              ___               &mac_prsc     ,    &kp PG_DN      &kp LEFT        &kp DOWN         &kp RIGHT        ___              ,
    PM_KEY          ___             ___              ___               ___           ,    ___            ___             ___              ___              ___              ,
                                                     ___               ___           ,    ___            ___
)

#ifdef CONFIG_TRACKBALL
ZMK_BASE_LAYER(Snipe,
    ___             ___             ___              ___               ___           ,    ___            ___             ___              ___              ___              ,
    ___             ___             ___              ___               ___           ,    ___            ___             ___              ___              ___              ,
    ___             ___             ___              ___               ___           ,    ___            ___             ___              ___              ___              ,
                                                     ___               ___           ,    ___            ___
)
ZMK_BASE_LAYER(Warp,
    ___             ___             ___              ___               ___           ,    ___            ___             ___              ___              ___              ,
    ___             ___             ___              ___               ___           ,    ___            ___             ___              ___              ___              ,
    ___             ___             ___              ___               ___           ,    ___            ___             ___              ___              ___              ,
                                                     ___               ___           ,    ___            ___
)
ZMK_BASE_LAYER(Scroll,
    ___             ___             ___              ___               ___           ,    ___            ___             ___              ___              ___              ,
    ___             ___             ___              ___               ___           ,    ___            ___             ___              ___              ___              ,
    ___             ___             ___              ___               ___           ,    ___            ___             ___              ___              ___              ,
                                                     ___               ___           ,    ___            ___
)
#endif

