#define CONFIG_WIRELESS
#define ZMK_BASE_LAYER(name, LN, RN, LT, RT, LM, RM, LB, RB, LH, RH, sensors)  \
    ZMK_LAYER(                                                                 \
        name,                                                                  \
                 LN RN                                                         \
                 LT RT                                                         \
                 LM RM                                                         \
                 LB RB                                                         \
                 LH &mo LOWER &kp RET &kp SPACE &mo RAISE RH,                  \
                 sensors                                                       \
    )

#include "zmk-helpers/key-labels/sofle.h"
#include "base.keymap"
