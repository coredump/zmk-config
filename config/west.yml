## config/west.yml
```yaml
manifest:
  defaults:
    revision: main
  remotes:
    - name: urob
      url-base: https://github.com/urob
    - name: zmkfirmware
      url-base: https://github.com/zmkfirmware
    - name: Good-Great-Grand-Wonderful
      url-base: https://github.com/Good-Great-Grand-Wonderful
    - name: efogdev
      url-base: https://github.com/efogdev
    - name: badjeff
      url-base: https://github.com/badjeff
    - name: caksoylar
      url-base: https://github.com/caksoylar

  projects:
    - name: zmk
      remote: zmkfirmware
      revision: ac7f75b8591d39aaf3b66b9d26f26c9ed921a009
      import: app/west.yml

    # ZMK modules
    - name: zmk-helpers
      path: modules/zmk/helpers
      remote: urob
    - name: zmk-adaptive-key
      path: modules/zmk/adaptive-key
      remote: urob
    - name: zmk-auto-layer
      path: modules/zmk/auto-layer
      remote: urob
    - name: zmk-leader-key
      path: modules/zmk/leader-key
      remote: urob
    - name: zmk-tri-state
      path: modules/zmk/tri-state
      remote: urob

    - name: gggw-zmk-keebs
      remote: Good-Great-Grand-Wonderful
      path: modules/gggw
      revision: zephyr-4.1

      # unfolded those from gggw west.yml so I can set the path on individual modules
    - name: zmk-pmw3610-driver
      remote: efogdev
      revision: zephyr-4.1
      path: modules/zmk/pmw3610-driver
    - name: zmk-report-rate-limit
      remote: efogdev
      revision: main
      path: modules/zmk/report-rate-limit
    - name: zmk-input-processor-xyz
      remote: badjeff
      revision: main
      path: modules/zmk/input-processor-xyz
    - name: zmk-rgbled-widget
      remote: caksoylar
      revision: e9472d6c59b8e901753dfa6c337c1b24cb70f571
      path: modules/zmk/rgbled-widget

  self:
    path: config
```
