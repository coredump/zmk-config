#define CONFIG_WIRELESS
#define ZMK_BASE_LAYER(name, LT, RT, LM, RM, LB, RB, LH, RH)  \
    ZMK_LAYER(                                                                 \
        name,                                                                  \
                 LT RT                                                         \
                 LM RM                                                         \
                 LB RB                                                         \
                 LH &lt TAB LOWER &kp RET &ak_space &lt BSPC RAISE RH          \
    )

#include "zmk-helpers/key-labels/totem.h"
#include "base.keymap"
