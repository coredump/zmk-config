#define CONFIG_WIRELESS
#define LILY58_STANDARD_LABELS
#define ZMK_BASE_LAYER(name, LT, RT, LM, RM, LB, RB, LH, RH)  \
    ZMK_LAYER(                                                                 \
        name,                                                                  \
         &kp GRAVE &kp N1 &kp N2 &kp N3 &kp N4 &kp N5    &kp N6 &kp N7 &kp N8 &kp N9 &kp N0 &kp BSPC  \
         &kp TAB   LT RT &kp BSPC                                                         \
         &kp ESC   LM RM &kp SQT                                                         \
         &kp LCTRL LB &none &none RB &kp RSFT                                                         \
                &none SMART_NUM LH RH SMART_SHIFT &none                  \
    )

#define THUMBS LH0 LH1 LH2 LH3 RH0 RH1 RH2 RH3

#include "zmk-helpers/key-labels/lily58.h"
#include "base.keymap"